// SPDX-License-Identifier: GPL-2.0-only OR MIT
/*
 * Copyright (c) 2025-2026 Ben Grisdale <bengris32@protonmail.ch>
 * Copyright (c) 2025-2026 Jack Matthews <jack@jackmatthe.ws>
 */

/dts-v1/;

#include "mt8163-amazon-show.dtsi"

/ {
	model = "Amazon Echo Show 5 (2021)";
	compatible = "amazon,cronos", "mediatek,mt8163";
	chassis-type = "embedded";
};
