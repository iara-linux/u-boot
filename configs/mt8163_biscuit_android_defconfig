## configs/mt8163_biscuit_android_defconfig
```kconfig
#include <configs/mt8163-amazon-android.config>
CONFIG_ENV_SOURCE_FILE="env/biscuit-android"
CONFIG_DEFAULT_DEVICE_TREE="mt8163-amazon-biscuit"
CONFIG_OF_LIST="mt8163-amazon-biscuit"
CONFIG_LED=y
CONFIG_LED_IS31FL3236=y
CONFIG_CMD_LED=y
CONFIG_CMD_AMZN_BCB=y
```

## configs/mt8163_biscuit_defconfig
```kconfig
#include <configs/mt8163-amazon.config>
CONFIG_ENV_SOURCE_FILE="env/biscuit"
CONFIG_DEFAULT_DEVICE_TREE="mt8163-amazon-biscuit"
CONFIG_OF_LIST="mt8163-amazon-biscuit"
CONFIG_LED=y
CONFIG_LED_IS31FL3236=y
CONFIG_CMD_LED=y
```

## configs/mt8163_checkers_android_defconfig
```kconfig
#include <configs/mt8163-amazon-headed-android.config>
CONFIG_ENV_SOURCE_FILE="env/checkers-android"
CONFIG_DEFAULT_DEVICE_TREE="mt8163-amazon-checkers"
CONFIG_OF_LIST="mt8163-amazon-checkers"
CONFIG_VIDEO_LCD_AMAZON_ST7701S=y
```

## configs/mt8163_checkers_defconfig
```kconfig
#include <configs/mt8163-amazon-headed.config>
CONFIG_ENV_SOURCE_FILE="env/checkers"
CONFIG_DEFAULT_DEVICE_TREE="mt8163-amazon-checkers"
CONFIG_OF_LIST="mt8163-amazon-checkers"
CONFIG_VIDEO_LCD_AMAZON_ST7701S=y
```

## configs/mt8163_cronos_android_defconfig
```kconfig
#include <configs/mt8163-amazon-headed-android.config>
CONFIG_ENV_SOURCE_FILE="env/cronos-android"
CONFIG_DEFAULT_DEVICE_TREE="mt8163-amazon-cronos"
CONFIG_OF_LIST="mt8163-amazon-cronos"
CONFIG_VIDEO_LCD_AMAZON_ST7701S=y
```

## configs/mt8163_cronos_defconfig
```kconfig
#include <configs/mt8163-amazon-headed.config>
CONFIG_ENV_SOURCE_FILE="env/cronos"
CONFIG_DEFAULT_DEVICE_TREE="mt8163-amazon-cronos"
CONFIG_OF_LIST="mt8163-amazon-cronos"
CONFIG_VIDEO_LCD_AMAZON_ST7701S=y
CONFIG_GOODIX_TOUCHPANEL=y
CONFIG_CMD_TILEMENU_ROTATED=y
```

## configs/mt8163_crown_android_defconfig
```kconfig
#include <configs/mt8163-amazon-headed-android.config>
CONFIG_ENV_SOURCE_FILE="env/crown-android"
CONFIG_DEFAULT_DEVICE_TREE="mt8163-amazon-crown"
CONFIG_OF_LIST="mt8163-amazon-crown"
CONFIG_VIDEO_LCD_AMAZON_JD936X=y
CONFIG_PMIC_TPS65132=y
CONFIG_DM_REGULATOR_TPS65132=y
```

## configs/mt8163_crown_defconfig
```kconfig
#include <configs/mt8163-amazon.config>
CONFIG_ENV_SOURCE_FILE="env/crown"
CONFIG_DEFAULT_DEVICE_TREE="mt8163-amazon-crown"
CONFIG_OF_LIST="mt8163-amazon-crown"
```

## configs/mt8163_douglas_defconfig
```kconfig
#include <configs/mt8163-amazon.config>
CONFIG_ENV_SOURCE_FILE="env/douglas"
CONFIG_DEFAULT_DEVICE_TREE="mt8163-amazon-douglas"
CONFIG_OF_LIST="mt8163-amazon-douglas"
```

## configs/mt8163_giza_defconfig
```kconfig
#include <configs/mt8163-amazon.config>
CONFIG_ENV_SOURCE_FILE="env/giza"
CONFIG_DEFAULT_DEVICE_TREE="mt8163-amazon-giza"
CONFIG_OF_LIST="mt8163-amazon-giza"
```

## configs/mt8163_karnak_defconfig
```kconfig
#include <configs/mt8163-amazon.config>
CONFIG_ENV_SOURCE_FILE="env/karnak"
CONFIG_DEFAULT_DEVICE_TREE="mt8163-amazon-karnak"
CONFIG_OF_LIST="mt8163-amazon-karnak"
```

## configs/mt8163_mustang_defconfig
```kconfig
#include <configs/mt8163-amazon.config>
CONFIG_ENV_SOURCE_FILE="env/mustang"
CONFIG_DEFAULT_DEVICE_TREE="mt8163-amazon-mustang"
CONFIG_OF_LIST="mt8163-amazon-mustang"
```

## configs/mt8163_radar_defconfig
```kconfig
#include <configs/mt8163-amazon.config>
CONFIG_ENV_SOURCE_FILE="env/radar"
CONFIG_DEFAULT_DEVICE_TREE="mt8163-amazon-radar"
CONFIG_OF_LIST="mt8163-amazon-radar"
```

## configs/mt8163_rook_defconfig
```kconfig
#include <configs/mt8163-amazon.config>
CONFIG_ENV_SOURCE_FILE="env/rook"
CONFIG_DEFAULT_DEVICE_TREE="mt8163-amazon-rook"
CONFIG_OF_LIST="mt8163-amazon-rook"
```

## configs/mt8516_cupcake_android_defconfig
```kconfig
#include <configs/mt8516-amazon-android.config>
CONFIG_ENV_SOURCE_FILE="env/cupcake-android"
CONFIG_DEFAULT_DEVICE_TREE="mt8516-amazon-cupcake"
CONFIG_OF_LIST="mt8516-amazon-cupcake"
CONFIG_CMD_AMZN_BCB=y
```

## configs/mt8516_cupcake_defconfig
```kconfig
#include <configs/mt8516-amazon.config>
CONFIG_ENV_SOURCE_FILE="env/cupcake"
CONFIG_DEFAULT_DEVICE_TREE="mt8516-amazon-cupcake"
CONFIG_OF_LIST="mt8516-amazon-cupcake"
```
